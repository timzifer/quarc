VERSION ""

NS_ :

BS_:
BU_: Burner
BO_ 481845248 CombustionChamberTemperature: 4 Burner
   SG_ CombustionChamberTemperature : 15|16@0+ (0.1,0) [0|9999] "°C" Vector__XXX

BO_ 481845249 CauldronTemperature: 4 Burner
   SG_ CauldronTemperature : 15|16@0+ (0.1,0) [0|120] "°C" Burner

BA_DEF_ BO_ "GenMsgBackgroundColor" STRING ;
BA_DEF_ BO_ "GenMsgForegroundColor" STRING ;
BA_DEF_ BO_ "filterlabeling" INT 0 0;
BA_DEF_DEF_ "GenMsgBackgroundColor" "#ffffff";
BA_DEF_DEF_ "GenMsgForegroundColor" "#000000";
BA_DEF_DEF_ "filterlabeling" 1;
CM_ BU_ Burner "Burner";
